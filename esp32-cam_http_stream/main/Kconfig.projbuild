## esp32-cam_http_stream/main/Kconfig.projbuild
```kconfig
# Kconfig file for ESP32-CAM HTTP Stream

menu "WiFi Configuration"

config ESP_WIFI_SSID
    string "WiFi SSID"
    default "myssid"
    help
        SSID (network name) for the example to connect to.

config ESP_WIFI_PASSWORD
    string "WiFi Password"
    default "mypassword"
    help
        WiFi password (WPA or WPA2) for the example to use.

config ESP_MAXIMUM_RETRY
    int "Maximum retry"
    default 5
    help
        Set the Maximum retry to avoid station reconnecting to the AP unlimited when the AP is really inexistent.

endmenu

menu "HTTP Authentication"

config HTTP_AUTH_ENABLED
    bool "Enable HTTP Basic Authentication"
    default y
    help
        Enable HTTP Basic Authentication for web interface access.

config HTTP_AUTH_USERNAME
    string "HTTP Username"
    default "admin"
    depends on HTTP_AUTH_ENABLED
    help
        Username for HTTP Basic Authentication.

config HTTP_AUTH_PASSWORD
    string "HTTP Password"
    default "admin"
    depends on HTTP_AUTH_ENABLED
    help
        Password for HTTP Basic Authentication.

endmenu
```

## esp32-cam_http_stream/sdkconfig.defaults
```kconfig
# ESP-IDF Project Configuration

# WiFi Configuration
CONFIG_ESP_WIFI_SSID="lulumi_ap"
CONFIG_ESP_WIFI_PASSWORD="1978120505"
CONFIG_ESP_MAXIMUM_RETRY=5

# LWIP
CONFIG_LWIP_MAX_SOCKETS=10
CONFIG_LWIP_SO_REUSE=y
CONFIG_LWIP_SO_REUSE_RXTOALL=y

# HTTP Server
CONFIG_HTTPD_MAX_REQ_HDR_LEN=1024
CONFIG_HTTPD_MAX_URI_LEN=512

# Camera
CONFIG_CAMERA_CORE0=y
CONFIG_CAMERA_DMA_BUFFER_SIZE_MAX=32768

# PSRAM Configuration - AI-Thinker ESP32-CAM (4MB PSRAM)
CONFIG_ESP32_SPIRAM_SUPPORT=y
CONFIG_SPIRAM=y
CONFIG_SPIRAM_BOOT_INIT=y
CONFIG_SPIRAM_IGNORE_NOTFOUND=n
CONFIG_SPIRAM_USE_MALLOC=y
CONFIG_SPIRAM_TYPE_AUTO=y
CONFIG_SPIRAM_SIZE=-1
CONFIG_SPIRAM_SPEED_40M=y
CONFIG_SPIRAM_CACHE_WORKAROUND=y
CONFIG_SPIRAM_BANKSWITCH_ENABLE=y
CONFIG_SPIRAM_BANKSWITCH_RESERVE=8
CONFIG_SPIRAM_ALLOW_BSS_SEG_EXTERNAL_MEMORY=y
CONFIG_SPIRAM_MALLOC_ALWAYSINTERNAL=16384
CONFIG_SPIRAM_MALLOC_RESERVE_INTERNAL=32768

# Partition
CONFIG_PARTITION_TABLE_CUSTOM=y
CONFIG_PARTITION_TABLE_CUSTOM_FILENAME="partitions.csv"
CONFIG_PARTITION_TABLE_FILENAME="partitions.csv"

# Flash size
CONFIG_ESPTOOLPY_FLASHSIZE_4MB=y
CONFIG_ESPTOOLPY_FLASHSIZE="4MB"

# Log
CONFIG_LOG_DEFAULT_LEVEL_INFO=y
CONFIG_LOG_DEFAULT_LEVEL=3
```

## esp32-cam_led_test/sdkconfig.defaults
```kconfig
# ESP-IDF Project Configuration

# Serial Port Settings
CONFIG_ESPTOOLPY_PORT="COM3"
CONFIG_ESPTOOLPY_BAUD_115200B=y
CONFIG_ESPTOOLPY_BAUD=115200
CONFIG_ESPTOOLPY_COMPRESSED=y

# Monitor Settings
CONFIG_ESPTOOLPY_MONITOR_BAUD_115200B=y
CONFIG_ESPTOOLPY_MONITOR_BAUD=115200

# Flash Settings
CONFIG_ESPTOOLPY_FLASHMODE_DIO=y
CONFIG_ESPTOOLPY_FLASHFREQ_40M=y
CONFIG_ESPTOOLPY_FLASHSIZE_4MB=y

# Log Settings
CONFIG_LOG_DEFAULT_LEVEL_INFO=y
CONFIG_LOG_DEFAULT_LEVEL=3
```
